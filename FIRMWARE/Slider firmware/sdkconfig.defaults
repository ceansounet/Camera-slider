## FIRMWARE/Slider firmware/sdkconfig.defaults
```kconfig
# WiFi AP
CONFIG_ESP_WIFI_SOFTAP_SUPPORT=y
CONFIG_ESP_WIFI_AP_CHANNEL=6

# Task stack sizes
CONFIG_ESP_MAIN_TASK_STACK_SIZE=8192

# NVS partition for saving positions
CONFIG_NVS_ASSERT_ERROR_CHECK=n

# HTTPD
CONFIG_HTTPD_MAX_REQ_HDR_LEN=1024
CONFIG_HTTPD_MAX_URI_LEN=512
CONFIG_HTTPD_MAX_RESP_HEADERS_LEN=1024
CONFIG_HTTPD_WS_SUPPORT=y

# FreeRTOS
CONFIG_FREERTOS_HZ=1000

# Log level
CONFIG_LOG_DEFAULT_LEVEL_INFO=y
CONFIG_LOG_MAXIMUM_LEVEL_DEBUG=y

# UART for controller link
CONFIG_ESP_CONSOLE_UART_DEFAULT=y
```
